/* Backtracking spawn metadata. Augment the native GNU ld ELF layout. */
SECTIONS
{
  .opencilk_spawn_map : ALIGN(8)
  {
    /* A linker-generated byte makes this PROGBITS/ALLOC. LLVM marks its
       input metadata non-ALLOC; a bare output section would not be mapped. */
    BYTE(0);
    . = ALIGN(8);
    _SPAWN_ADDR_MAP_START_ = .;
    KEEP(*(.llvm_bb_spawn_addr_map))
    _SPAWN_ADDR_MAP_END_ = .;
  }
}
INSERT AFTER .rodata;
